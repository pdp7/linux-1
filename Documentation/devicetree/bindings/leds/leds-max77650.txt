## Documentation/devicetree/bindings/leds/leds-max77650.yaml
```yaml
# SPDX-License-Identifier: GPL-2.0
%YAML 1.2
---
$id: http://devicetree.org/schemas/leds/leds-max77650.yaml#
$schema: http://devicetree.org/meta-schemas/core.yaml#

title: LED driver for MAX77650 PMIC from Maxim Integrated.

maintainers:
  - Bartosz Golaszewski <bgolaszewski@baylibre.com>

description: |
  This module is part of the MAX77650 MFD device. For more details
  see Documentation/devicetree/bindings/mfd/max77650.txt.

  The LED controller is represented as a sub-node of the PMIC node on
  the device tree.

  This device has three current sinks.

properties:
  compatible:
    const: maxim,max77650-led

  "#address-cells":
    const: 1

  "#size-cells":
    const: 0

patternProperties:
  "^led@[0-2]$":
    type: object
    description: |
      Properties for a single LED.

    properties:
      reg:
        description:
          Index of the LED.
        maxItems: 1
        minimum: 0
        maximum: 2

      label:
        $ref: "/schemas/types.yaml#/definitions/string"
        description:
          The label of this LED.

      linux,default-trigger:
        $ref: "/schemas/types.yaml#/definitions/string"
        description:
          String defining the default trigger assigned to this LED.

required:
  - compatible
  - "#address-cells"
  - "#size-cells"

examples:
  - |
    leds {
        compatible = "maxim,max77650-led";
        #address-cells = <1>;
        #size-cells = <0>;

        led@0 {
            reg = <0>;
            label = "blue:usr0";
        };

        led@1 {
            reg = <1>;
            label = "red:usr1";
            linux,default-trigger = "heartbeat";
        };

        led@2 {
            reg = <2>;
            label = "green:usr2";
        };
    };
```

## Documentation/devicetree/bindings/mfd/max77650.yaml
```yaml
# SPDX-License-Identifier: GPL-2.0
%YAML 1.2
---
$id: http://devicetree.org/schemas/mfd/max77650.yaml#
$schema: http://devicetree.org/meta-schemas/core.yaml#

title: MAX77650 ultra low-power PMIC from Maxim Integrated.

maintainers:
  - Bartosz Golaszewski <bgolaszewski@baylibre.com>

description: |
  This document describes the DT properties of the core MFD controller.

  The GPIO-controller module is represented as part of the top-level PMIC
  node. The device exposes a single GPIO line.

  For device-tree bindings of other sub-modules (regulator, power supply,
  LEDs and onkey) refer to the binding documents under the respective
  sub-system directories.

  For more details on GPIO bindings, please refer to the generic GPIO DT
  binding document <devicetree/bindings/gpio/gpio.txt>.

properties:
  compatible:
    const: maxim,max77650

  reg:
    description:
      I2C device address.
    maxItems: 1

  interrupts:
    description:
      The interrupt on the parent the controller is connected to.
    maxItems: 1

  interrupt-controller: true

  "#interrupt-cells":
    const: 2
    description:
      The first cell is the IRQ number, the second cell is the trigger type.

  gpio-controller: true

  "#gpio-cells":
    const: 2
    description:
      The first cell is the pin number and the second cell is used to specify
      the gpio active state.

  gpio-line-names:
    $ref: '/schemas/types.yaml#/definitions/string-array'
    maxItems: 1
    description:
      Single string containing the name of the GPIO line.

required:
  - compatible
  - reg
  - interrupts
  - interrupt-controller
  - "#interrupt-cells"
  - gpio-controller
  - "#gpio-cells"

examples:
  - |
    pmic@48 {
        compatible = "maxim,max77650";
        reg = <0x48>;

        interrupt-controller;
        interrupt-parent = <&gpio2>;
        #interrupt-cells = <2>;
        interrupts = <3 IRQ_TYPE_LEVEL_LOW>;

        gpio-controller;
        #gpio-cells = <2>;
        gpio-line-names = "max77650-charger";
    };
```

## Documentation/devicetree/bindings/regulator/max77650-regulator.yaml
```yaml
# SPDX-License-Identifier: GPL-2.0
%YAML 1.2
---
$id: http://devicetree.org/schemas/regulator/max77650-regulator.yaml#
$schema: http://devicetree.org/meta-schemas/core.yaml#

title: Regulator driver for MAX77650 PMIC from Maxim Integrated.

maintainers:
  - Bartosz Golaszewski <bgolaszewski@baylibre.com>

description: |
  This module is part of the MAX77650 MFD device. For more details
  see Documentation/devicetree/bindings/mfd/max77650.txt.

  The regulator controller is represented as a sub-node of the PMIC node
  on the device tree.

  The device has a single LDO regulator and a SIMO buck-boost regulator with
  three independent power rails.

properties:
  compatible:
    const: maxim,max77650-regulator

patternProperties:
  "^regulator@[0-3]$":
    $ref: "regulator.yaml#"

required:
  - compatible

examples:
  - |
    regulators {
        compatible = "maxim,max77650-regulator";

        max77650_ldo: regulator@0 {
            regulator-compatible = "ldo";
            regulator-name = "max77650-ldo";
            regulator-min-microvolt = <1350000>;
            regulator-max-microvolt = <2937500>;
        };

        max77650_sbb0: regulator@1 {
            regulator-compatible = "sbb0";
            regulator-name = "max77650-sbb0";
            regulator-min-microvolt = <800000>;
            regulator-max-microvolt = <1587500>;
        };
    };
```
